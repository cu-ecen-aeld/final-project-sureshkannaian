## build/conf/bblayers.conf
```bitbake
# standard
POKY_BBLAYERS_CONF_VERSION = "2"
BBPATH = "${TOPDIR}"
BBFILES ?= ""

BBLAYERS ?= " \
    ${TOPDIR}/../layers/meta-openembedded/meta-networking \
    ${TOPDIR}/../layers/meta-openembedded/meta-oe \
    ${TOPDIR}/../layers/meta-openembedded/meta-perl \
    ${TOPDIR}/../layers/meta-openembedded/meta-python \
    ${TOPDIR}/../layers/meta-qt5 \
    ${TOPDIR}/../layers/poky/meta \
    ${TOPDIR}/../layers/poky/meta-poky \
    ${TOPDIR}/../layers/poky/meta-yocto-bsp \
    ${TOPDIR}/../meta-raspberrypi \
    ${TOPDIR}/../meta-aesd"
BBPATH ?= "${TOPDIR}"
BBFILES ??= ""
```

## build/conf/local.conf
```bitbake
MACHINE ??= "qemux86-64"
DISTRO ??= "poky"

EXTRA_IMAGE_FEATURES ?= "debug-tweaks"
USER_CLASSES ?= "buildstats"

PATCHRESOLVE = "noop"

BB_DISKMON_DIRS ??= "\
    STOPTASKS,${TMPDIR},1G,100K \
    STOPTASKS,${DL_DIR},1G,100K \
    STOPTASKS,${SSTATE_DIR},1G,100K \
    STOPTASKS,/tmp,100M,100K \
    HALT,${TMPDIR},100M,1K \
    HALT,${DL_DIR},100M,1K \
    HALT,${SSTATE_DIR},100M,1K \
    HALT,/tmp,10M,1K"

PACKAGECONFIG:append:pn-qemu-system-native = " sdl"
CONF_VERSION = "2"


LICENSE_FLAGS_ACCEPTED += "synaptics-killswitch"

MACHINE = "raspberrypi4-64"
IMAGE_FSTYPES = "wic.bz2 rpi-sdimg"

# Additional configurations (optional)
IMAGE_INSTALL:append = " linux-firmware-rpidistro-bcm43455 v4l-utils python3 ntp wpa-supplicant"
IMAGE_FEATURES += "ssh-server-openssh"
DISTRO_FEATURES:append = "wifi"
BOOT_SPACE = "1073741"

GPU_MEM = "128"
ENABLE_UART = "1"
RPI_USE_U_BOOT = "1"

QA_SKIP = "license-checksum"
```
